/ {
    kscan0: kscan {
        compatible = "zmk,kscan-gpio-matrix";
        diode-direction = "row2col";

        row-gpios = <
            &pro_micro 21 (GPIO_ACTIVE_LOW | GPIO_PULL_UP)
        >;

        col-gpios = <
            &pro_micro 3 GPIO_ACTIVE_LOW
        >;
    };

    default_transform: keymap_transform {
        compatible = "zmk,matrix-transform";

        rows = <5>;
        columns = <6>;

        map = <
	     0  1  2  3  4  5
	     6  7  8  9 10 11
	    12 13 14 15 16 17
	    18 19 20 21 22 23
	    24 25 26 27 28 29
	>;
    };
};