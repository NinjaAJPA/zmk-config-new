#include "split5x6.dtsi"

/ {
    chosen {
        zmk,kscan = &kscan0;
	zmk,matrix-transform = &default_transform;
    };
};

&kscan0 {
    col-gpios = <
	&pro_micro 3 GPIO_ACTIVE_UP
        &pro_micro 4 GPIO_ACTIVE_UP
        &pro_micro 5 GPIO_ACTIVE_UP
        &pro_micro 6 GPIO_ACTIVE_UP
        &pro_micro 7 GPIO_ACTIVE_UP
    >;
    row-gpios = < 
	&pro_micro 21 (GPIO_ACTIVE_UP | GPIO_PULL_LOW)
        &pro_micro 20 (GPIO_ACTIVE_UP | GPIO_PULL_LOW)
        &pro_micro 19 (GPIO_ACTIVE_UP | GPIO_PULL_LOW)
        &pro_micro 18 (GPIO_ACTIVE_UP | GPIO_PULL_LOW)
        &pro_micro 15 (GPIO_ACTIVE_UP | GPIO_PULL_LOW)
    >;
};