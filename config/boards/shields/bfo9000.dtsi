#include <dt-bindings/zmk/matrix_transform.h>

/ {
    chosen {
        zmk,kscan = &kscan0;
    };

    kscan0: kscan {
        compatible = "zmk,kscan-gpio-matrix";
        wakeup-source;
        diode-direction = "col2row";
        row-gpios = <
            &pro_micro 21 (GPIO_ACTIVE_HIGH | GPIO_PULL_DOWN) // Row A
            &pro_micro 20 (GPIO_ACTIVE_HIGH | GPIO_PULL_DOWN) // Row B
            &pro_micro 19 (GPIO_ACTIVE_HIGH | GPIO_PULL_DOWN) // Row C
            &pro_micro 18 (GPIO_ACTIVE_HIGH | GPIO_PULL_DOWN) // Row D
            &pro_micro 15 (GPIO_ACTIVE_HIGH | GPIO_PULL_DOWN) // Row E
        >;
    };
};